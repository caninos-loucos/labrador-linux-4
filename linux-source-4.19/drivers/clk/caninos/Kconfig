## linux-source-4.19/drivers/clk/caninos/Kconfig
```kconfig
config CLK_GPU_CANINOS
    bool
    depends on CLK_CANINOS

config CLK_CANINOS
	bool "Clock driver for Caninos Labrador SoCs"
	depends on ARCH_CANINOS_K7 || COMPILE_TEST
	select REGMAP_MMIO
	select RESET_CONTROLLER
    select CLK_GPU_CANINOS
	default ARCH_CANINOS_K7
```

## linux-source-4.19/drivers/dma/caninos/Kconfig
```kconfig
config DMA_CANINOS
	bool "Caninos K7 Labrador DMA support"
	depends on ARCH_CANINOS_K7 || COMPILE_TEST
	select DMA_ENGINE
	select DMA_VIRTUAL_CHANNELS
	help
	  Enable support for the Caninos Labrador DMA controllers.
```

## linux-source-4.19/drivers/gpu/drm/caninos/Kconfig
```kconfig
# SPDX-License-Identifier: GPL-2.0-only
config DRM_CANINOS_HDMI
	bool
	depends on DRM_CANINOS
	
config DRM_CANINOS
	bool "DRM driver for Caninos K7"
	depends on DRM && OF
	depends on (COMPILE_TEST || ARCH_CANINOS_K7)
	select DRM_KMS_HELPER
	select DRM_KMS_CMA_HELPER
	select DMA_CMA if HAVE_DMA_CONTIGUOUS
	select CMA if HAVE_DMA_CONTIGUOUS
	select DRM_CANINOS_HDMI
	help
	 This is a KMS driver for Caninos K7
```

## linux-source-4.19/drivers/pinctrl/caninos/Kconfig
```kconfig
config PINCTRL_CANINOS
	bool "Caninos K7 Labrador pin controller driver"
	depends on ARCH_CANINOS_K7
	select PINMUX
	select GENERIC_PINCONF
	select GPIOLIB_IRQCHIP
	select OF_GPIO
	help
	  Say yes here to support the gpio/pin control module on
	  Caninos Labrador SBC.
```

## linux-source-4.19/drivers/reset/caninos/Kconfig
```kconfig
config RESET_CANINOS
	bool "Caninos K7 Labrador reset controller"
	depends on ARCH_CANINOS_K7 || COMPILE_TEST
	default ARCH_CANINOS_K7
	help
	  This enables the reset controller driver for Caninos Labrador boards.
```

## linux-source-4.19/drivers/soc/caninos/Kconfig
```kconfig
if ARCH_CANINOS_K7 || COMPILE_TEST

config CANINOS_PM_DOMAINS_HELPER
	bool

config CANINOS_PM_DOMAINS
	bool "Caninos K7 SPS power domains"
	depends on PM
	select CANINOS_PM_DOMAINS_HELPER
	select PM_GENERIC_DOMAINS
	help
	  Say 'y' here to enable support for Smart Power System (SPS)
	  power-gating on Caninos SoC.
	  If unsure, say 'n'.

endif
```

## linux-source-4.19/drivers/usb/caninos/Kconfig
```kconfig
#
# Actions usb2.0 controllers configuration
#

config USB_CANINOS
	tristate "Caninos K7 Labrador usb2.0 otg support"
	depends on ARCH_CANINOS_K7
	#default y
	---help---
	  The Actions chips have USB2.0 otg controllers. Enable
	  this option if your board uses this chip. If unsure, say N.

	  To compile this driver as a module, choose M here: the
	  module will be called aotg.

config USB_CANINOS_HCD
	tristate "Caninos usb2.0 HCD support"
	depends on USB_CANINOS
	#default y
	---help---
	  The Actions USB2.0 otg controllers have USB2.0 host controllers. Enable
	  this option if your board uses this chip. If unsure, say N.
```
